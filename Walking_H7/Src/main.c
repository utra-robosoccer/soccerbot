/**
  ******************************************************************************
  * File Name          : main.c
  * Description        : Main program body
  ******************************************************************************
  ** This notice applies to any and all portions of this file
  * that are not between comment pairs USER CODE BEGIN and
  * USER CODE END. Other portions of this file, whether 
  * inserted by the user or by software development tools
  * are owned by their respective copyright owners.
  *
  * COPYRIGHT(c) 2018 STMicroelectronics
  *
  * Redistribution and use in source and binary forms, with or without modification,
  * are permitted provided that the following conditions are met:
  *   1. Redistributions of source code must retain the above copyright notice,
  *      this list of conditions and the following disclaimer.
  *   2. Redistributions in binary form must reproduce the above copyright notice,
  *      this list of conditions and the following disclaimer in the documentation
  *      and/or other materials provided with the distribution.
  *   3. Neither the name of STMicroelectronics nor the names of its contributors
  *      may be used to endorse or promote products derived from this software
  *      without specific prior written permission.
  *
  * THIS SOFTWARE IS PROVIDED BY THE COPYRIGHT HOLDERS AND CONTRIBUTORS "AS IS"
  * AND ANY EXPRESS OR IMPLIED WARRANTIES, INCLUDING, BUT NOT LIMITED TO, THE
  * IMPLIED WARRANTIES OF MERCHANTABILITY AND FITNESS FOR A PARTICULAR PURPOSE ARE
  * DISCLAIMED. IN NO EVENT SHALL THE COPYRIGHT HOLDER OR CONTRIBUTORS BE LIABLE
  * FOR ANY DIRECT, INDIRECT, INCIDENTAL, SPECIAL, EXEMPLARY, OR CONSEQUENTIAL
  * DAMAGES (INCLUDING, BUT NOT LIMITED TO, PROCUREMENT OF SUBSTITUTE GOODS OR
  * SERVICES; LOSS OF USE, DATA, OR PROFITS; OR BUSINESS INTERRUPTION) HOWEVER
  * CAUSED AND ON ANY THEORY OF LIABILITY, WHETHER IN CONTRACT, STRICT LIABILITY,
  * OR TORT (INCLUDING NEGLIGENCE OR OTHERWISE) ARISING IN ANY WAY OUT OF THE USE
  * OF THIS SOFTWARE, EVEN IF ADVISED OF THE POSSIBILITY OF SUCH DAMAGE.
  *
  ******************************************************************************
  */

/* Includes ------------------------------------------------------------------*/
#include "main.h"
#include "stm32h7xx_hal.h"
#include "i2c.h"
#include "usart.h"
#include "gpio.h"

/* USER CODE BEGIN Includes */
/* Motor driver. */
#include "../../Dynamixel_AX-12A_Driver/src/Dynamixel_AX-12A.h"
#include "../../Dynamixel_AX-12A_Driver/src/Dynamixel_AX-12A.c"

/* Motor Angles. */
#include "../../../../control/soccer-control/angles.h"
/* USER CODE END Includes */

/* Private variables ---------------------------------------------------------*/

/* USER CODE BEGIN PV */
/* Private variables ---------------------------------------------------------*/
extern const double MOTORANGLES[DIM][SIZE];
//const double MOTORANGLES[12][1001] = {
//		{//1
//				0.044595,0.033301,0.022335,0.011681,0.001322,-0.0087571,-0.018571,-0.028134,-0.03746,-0.046561,-0.05545,-0.064137,-0.072634,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0.056376
//		},
//		{//2
//	0.38545,0.39119,0.39712,0.40322,0.40949,0.41591,0.42247,0.42916,0.43597,0.44289,0.44991,0.45701,0.4642,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0.38311
//		},
//		{//3
//				-1.4042,-1.4083,-1.4122,-1.416,-1.4197,-1.4232,-1.4266,-1.4299,-1.4331,-1.4361,-1.439,-1.4418,-1.4445,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-1.4059
//		},
//		{//4
//				1.0187,1.0171,1.0151,1.0128,1.0102,1.0073,1.0042,1.0008,0.99711,0.99322,0.98912,0.98479,0.98027,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1.0228
//		},
//		{//5
//				-0.044595,-0.033301,-0.022335,-0.011681,-0.001322,0.0087571,0.018571,0.028134,0.03746,0.046561,0.05545,0.064137,0.072634,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-0.056376
//		},
//		{//6
//				0,0,0,0,0,0,0,0,0,0,0,0,0,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0
//		},
//		{//7
//				0,0,0,0,0,0,0,0,0,0,0,0,0,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0
//		},
//		{//8
//				-0.20433,-0.19346,-0.18287,-0.17255,-0.16248,-0.15265,-0.14304,-0.13366,-0.12448,-0.11549,-0.10669,-0.098061,-0.089599,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-0.2155
//		},
//		{//9
//				0.67175,0.66956,0.66692,0.66386,0.66039,0.65655,0.65235,0.64781,0.64296,0.63781,0.63237,0.62667,0.62071,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0.67346
//		},
//		{//10
//				-1.4973,-1.5016,-1.5055,-1.5089,-1.5119,-1.5146,-1.5168,-1.5188,-1.5204,-1.5216,-1.5226,-1.5232,-1.5236,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-1.4925
//		},
//		{//11
//				0.82551,0.83202,0.83853,0.84504,0.85153,0.85802,0.8645,0.87096,0.8774,0.88381,0.8902,0.89656,0.90288,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0.819
//		},
//		{//12
//				0.20433,0.19346,0.18287,0.17255,0.16248,0.15265,0.14304,0.13366,0.12448,0.11549,0.10669,0.098061,0.089599,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0.2155
//		}
//};

const enum motorNames {MOTOR1, MOTOR2, MOTOR3, MOTOR4, MOTOR5,
					   MOTOR6, MOTOR7, MOTOR8, MOTOR9, MOTOR10,
					   MOTOR11, MOTOR12, MOTOR13, MOTOR14, MOTOR15,
					   MOTOR16, MOTOR17, MOTOR18
};

const double PI = 3.141592654;

Dynamixel_HandleTypeDef Motor1;
Dynamixel_HandleTypeDef Motor2;
Dynamixel_HandleTypeDef Motor3;
Dynamixel_HandleTypeDef Motor4;
Dynamixel_HandleTypeDef Motor5;
Dynamixel_HandleTypeDef Motor6;
Dynamixel_HandleTypeDef Motor7;
Dynamixel_HandleTypeDef Motor8;
Dynamixel_HandleTypeDef Motor9;
Dynamixel_HandleTypeDef Motor10;
Dynamixel_HandleTypeDef Motor11;
Dynamixel_HandleTypeDef Motor12;
Dynamixel_HandleTypeDef Motor13;
Dynamixel_HandleTypeDef Motor14;
Dynamixel_HandleTypeDef Motor15;
Dynamixel_HandleTypeDef Motor16;
Dynamixel_HandleTypeDef Motor17;
Dynamixel_HandleTypeDef Motor18;

/* USER CODE END PV */

/* Private function prototypes -----------------------------------------------*/
void SystemClock_Config(void);

/* USER CODE BEGIN PFP */
/* Private function prototypes -----------------------------------------------*/

/* USER CODE END PFP */

/* USER CODE BEGIN 0 */

/* USER CODE END 0 */

int main(void)
{

  /* USER CODE BEGIN 1 */

  /* USER CODE END 1 */

  /* MCU Configuration----------------------------------------------------------*/

  /* Reset of all peripherals, Initializes the Flash interface and the Systick. */
  HAL_Init();

  /* USER CODE BEGIN Init */

  /* USER CODE END Init */

  /* Configure the system clock */
  SystemClock_Config();

  /* USER CODE BEGIN SysInit */

  /* USER CODE END SysInit */

  /* Initialize all configured peripherals */
  MX_GPIO_Init();
  MX_UART7_Init();
  MX_UART4_Init();
  MX_USART1_UART_Init();
  MX_USART2_UART_Init();
  MX_UART5_Init();
  MX_I2C1_Init();

  /* USER CODE BEGIN 2 */
  Dynamixel_Init(&Motor1, 1, &huart2, GPIOD, GPIO_PIN_7);
  Dynamixel_Init(&Motor2, 2, &huart2, GPIOD, GPIO_PIN_7);
  Dynamixel_Init(&Motor3, 3, &huart2, GPIOD, GPIO_PIN_7);
  Dynamixel_Init(&Motor4, 4, &huart1, GPIOB, GPIO_PIN_10);
  Dynamixel_Init(&Motor5, 5, &huart1, GPIOB, GPIO_PIN_10);
  Dynamixel_Init(&Motor6, 6, &huart1, GPIOB, GPIO_PIN_10);
  Dynamixel_Init(&Motor7, 7, &huart7, GPIOA, GPIO_PIN_15);
  Dynamixel_Init(&Motor8, 8, &huart7, GPIOA, GPIO_PIN_15);
  Dynamixel_Init(&Motor9, 9, &huart7, GPIOA, GPIO_PIN_15);
  Dynamixel_Init(&Motor10, 10, &huart5, GPIOB, GPIO_PIN_0);
  Dynamixel_Init(&Motor11, 11, &huart5, GPIOB, GPIO_PIN_0);
  Dynamixel_Init(&Motor12, 12, &huart5, GPIOB, GPIO_PIN_0);
  Dynamixel_Init(&Motor13, 13, &huart4, GPIOA, GPIO_PIN_0);
  Dynamixel_Init(&Motor14, 14, &huart4, GPIOA, GPIO_PIN_0);
  Dynamixel_Init(&Motor15, 15, &huart4, GPIOA, GPIO_PIN_0);
  Dynamixel_Init(&Motor16, 16, &huart4, GPIOA, GPIO_PIN_0);
  Dynamixel_Init(&Motor17, 17, &huart4, GPIOA, GPIO_PIN_0);
  Dynamixel_Init(&Motor18, 18, &huart4, GPIOA, GPIO_PIN_0);

  Dynamixel_HandleTypeDef* arrDynamixel[18];
  arrDynamixel[0] = &Motor1;
  arrDynamixel[1] = &Motor2;
  arrDynamixel[2] = &Motor3;
  arrDynamixel[3] = &Motor4;
  arrDynamixel[4] = &Motor5;
  arrDynamixel[5] = &Motor6;
  arrDynamixel[6] = &Motor7;
  arrDynamixel[7] = &Motor8;
  arrDynamixel[8] = &Motor9;
  arrDynamixel[9] = &Motor10;
  arrDynamixel[10] = &Motor11;
  arrDynamixel[11] = &Motor12;
  arrDynamixel[12] = &Motor13;
  arrDynamixel[13] = &Motor14;
  arrDynamixel[14] = &Motor15;
  arrDynamixel[15] = &Motor16;
  arrDynamixel[16] = &Motor17;
  arrDynamixel[17] = &Motor18;

  for(int i = 0; i < 18; i++){
	  Dynamixel_SetGoalVelocity(arrDynamixel[i], 100);
	  Dynamixel_SetCWComplianceSlope(arrDynamixel[i], 4);
	  Dynamixel_SetCCWComplianceSlope(arrDynamixel[i], 4);
  }

//  Dynamixel_SetCWComplianceSlope(arrDynamixel[MOTOR8], 1);
//  Dynamixel_SetCCWComplianceSlope(arrDynamixel[MOTOR8], 1);
  /* USER CODE END 2 */

  /* Infinite loop */
  /* USER CODE BEGIN WHILE */
  while (1)
  {
  /* USER CODE END WHILE */

  /* USER CODE BEGIN 3 */
	  for(int j = 0; j < SIZE; j ++){
		  for(int i = MOTOR1; i <= MOTOR12; i++){ // NB: i begins at 0 (i.e. Motor1 corresponds to i = 0)
			  switch(i){
				  case MOTOR1:	  Dynamixel_SetGoalPosition(arrDynamixel[i], -1*MOTORANGLES[i][j]*180/PI + 150 - 1);
								  break;
				  case MOTOR2:	  Dynamixel_SetGoalPosition(arrDynamixel[i], -1*MOTORANGLES[i][j]*180/PI + 150 + 3);
								  break;
				  case MOTOR3:	  Dynamixel_SetGoalPosition(arrDynamixel[i], -1*MOTORANGLES[i][j]*180/PI + 150 + 1);
								  break;
				  case MOTOR4:	  Dynamixel_SetGoalPosition(arrDynamixel[i], MOTORANGLES[i][j]*180/PI + 150 + 2);
								  break;
				  case MOTOR5:	  Dynamixel_SetGoalPosition(arrDynamixel[i], MOTORANGLES[i][j]*180/PI + 150 - 0);
								  break;
				  case MOTOR6:	  Dynamixel_SetGoalPosition(arrDynamixel[i], -1*MOTORANGLES[i][j]*180/PI + 150 + 0);
								  break;
				  case MOTOR7:	  Dynamixel_SetGoalPosition(arrDynamixel[i], MOTORANGLES[i][j]*180/PI + 150 + 0);
								  break;
				  case MOTOR8:	  Dynamixel_SetGoalPosition(arrDynamixel[i], MOTORANGLES[i][j]*180/PI + 150 - 3);
								  break;
				  case MOTOR9:	  Dynamixel_SetGoalPosition(arrDynamixel[i], -1*MOTORANGLES[i][j]*180/PI + 150 - 0);
								  break;
				  case MOTOR10:	  Dynamixel_SetGoalPosition(arrDynamixel[i], MOTORANGLES[i][j]*180/PI + 150 + 4);
								  break;
				  case MOTOR11:   Dynamixel_SetGoalPosition(arrDynamixel[i], MOTORANGLES[i][j]*180/PI + 150 + 1);
								  break;
				  case MOTOR12:	  Dynamixel_SetGoalPosition(arrDynamixel[i], -1*MOTORANGLES[i][j]*180/PI + 150 + 3);
								  break;
			  }
		  }
		  HAL_Delay(10); // Default from Lukas: 10
	  }
  }
  /* USER CODE END 3 */

}

/** System Clock Configuration
*/
void SystemClock_Config(void)
{

  RCC_OscInitTypeDef RCC_OscInitStruct;
  RCC_ClkInitTypeDef RCC_ClkInitStruct;
  RCC_PeriphCLKInitTypeDef PeriphClkInitStruct;

    /**Supply configuration update enable 
    */
  MODIFY_REG(PWR->CR3, PWR_CR3_SCUEN, 0);

    /**Configure the main internal regulator output voltage 
    */
  __HAL_PWR_VOLTAGESCALING_CONFIG(PWR_REGULATOR_VOLTAGE_SCALE1);

  while ((PWR->D3CR & (PWR_D3CR_VOSRDY)) != PWR_D3CR_VOSRDY) 
  {
    
  }
    /**Initializes the CPU, AHB and APB busses clocks 
    */
  RCC_OscInitStruct.OscillatorType = RCC_OSCILLATORTYPE_HSI;
  RCC_OscInitStruct.HSIState = RCC_HSI_DIV1;
  RCC_OscInitStruct.HSICalibrationValue = 16;
  RCC_OscInitStruct.PLL.PLLState = RCC_PLL_NONE;
  if (HAL_RCC_OscConfig(&RCC_OscInitStruct) != HAL_OK)
  {
    _Error_Handler(__FILE__, __LINE__);
  }

    /**Initializes the CPU, AHB and APB busses clocks 
    */
  RCC_ClkInitStruct.ClockType = RCC_CLOCKTYPE_HCLK|RCC_CLOCKTYPE_SYSCLK
                              |RCC_CLOCKTYPE_PCLK1|RCC_CLOCKTYPE_PCLK2
                              |RCC_CLOCKTYPE_D3PCLK1|RCC_CLOCKTYPE_D1PCLK1;
  RCC_ClkInitStruct.SYSCLKSource = RCC_SYSCLKSOURCE_HSI;
  RCC_ClkInitStruct.SYSCLKDivider = RCC_SYSCLK_DIV1;
  RCC_ClkInitStruct.AHBCLKDivider = RCC_HCLK_DIV1;
  RCC_ClkInitStruct.APB3CLKDivider = RCC_APB3_DIV1;
  RCC_ClkInitStruct.APB1CLKDivider = RCC_APB1_DIV1;
  RCC_ClkInitStruct.APB2CLKDivider = RCC_APB2_DIV1;
  RCC_ClkInitStruct.APB4CLKDivider = RCC_APB4_DIV1;

  if (HAL_RCC_ClockConfig(&RCC_ClkInitStruct, FLASH_LATENCY_0) != HAL_OK)
  {
    _Error_Handler(__FILE__, __LINE__);
  }

  PeriphClkInitStruct.PeriphClockSelection = RCC_PERIPHCLK_USART2|RCC_PERIPHCLK_UART4
                              |RCC_PERIPHCLK_UART7|RCC_PERIPHCLK_USART1
                              |RCC_PERIPHCLK_UART5|RCC_PERIPHCLK_I2C1;
  PeriphClkInitStruct.Usart234578ClockSelection = RCC_USART234578CLKSOURCE_D2PCLK1;
  PeriphClkInitStruct.Usart16ClockSelection = RCC_USART16CLKSOURCE_D2PCLK2;
  PeriphClkInitStruct.I2c123ClockSelection = RCC_I2C123CLKSOURCE_D2PCLK1;
  if (HAL_RCCEx_PeriphCLKConfig(&PeriphClkInitStruct) != HAL_OK)
  {
    _Error_Handler(__FILE__, __LINE__);
  }

    /**Configure the Systick interrupt time 
    */
  HAL_SYSTICK_Config(SystemCoreClock/1000);

    /**Configure the Systick 
    */
  HAL_SYSTICK_CLKSourceConfig(SYSTICK_CLKSOURCE_HCLK);

  /* SysTick_IRQn interrupt configuration */
  HAL_NVIC_SetPriority(SysTick_IRQn, 0, 0);
}

/* USER CODE BEGIN 4 */

/* USER CODE END 4 */

/**
  * @brief  This function is executed in case of error occurrence.
  * @param  None
  * @retval None
  */
void _Error_Handler(char * file, int line)
{
  /* USER CODE BEGIN Error_Handler_Debug */
  /* User can add his own implementation to report the HAL error return state */
  while(1) 
  {
  }
  /* USER CODE END Error_Handler_Debug */ 
}

#ifdef USE_FULL_ASSERT

/**
   * @brief Reports the name of the source file and the source line number
   * where the assert_param error has occurred.
   * @param file: pointer to the source file name
   * @param line: assert_param error line source number
   * @retval None
   */
void assert_failed(uint8_t* file, uint32_t line)
{
  /* USER CODE BEGIN 6 */
  /* User can add his own implementation to report the file name and line number,
    ex: printf("Wrong parameters value: file %s on line %d\r\n", file, line) */
  /* USER CODE END 6 */

}

#endif

/**
  * @}
  */ 

/**
  * @}
*/ 

/************************ (C) COPYRIGHT STMicroelectronics *****END OF FILE****/
